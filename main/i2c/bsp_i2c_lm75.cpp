/**
  ******************************************************************************
  * @file    bsp_i2c_lm75.c
  * @version V1.0
  * @date    2013-xx-xx
  * @brief   i2c LM75A应用函数bsp
  ******************************************************************************
  * @attention
  *
  * 实验平台:野火 F103-指南者 STM32 开发板 
  * 论坛    :http://www.firebbs.cn
  * 淘宝    :https://fire-stm32.taobao.com
  *
  ******************************************************************************
  */ 


#include "bsp_i2c_lm75.h"

/*
*********************************************************************************************************
*	函 数 名: LM75_CheckOk
*	功能说明: 判断LM75A是否正常
*	形    参：无
*	返 回 值: 1 表示正常， 0 表示不正常
*********************************************************************************************************
*/
uint8_t LM75_CheckOk(void)
{
	if (i2c_CheckDevice(LM75_ADDRESS) == 0)
	{
		return 1;
	}
	else
	{
		/* 失败后，切记发送I2C总线停止信号 */
		i2c_Stop();		
		return 0;
	}
}

/*
*********************************************************************************************************
*	函 数 名: LM75_readTemp
*	功能说明: 读取温度数据
*	形    参：无
*	返 回 值: 非0 表示正常， 0 表示不正常
*********************************************************************************************************
*/
float LM75_readTemp(void)
{
  int data;
  unsigned char tempH,tempL;
	
	if (LM75_CheckOk() == 0)
	{
		/* 没有检测到LM75温度传感器 */
		printf("没有检测到LM75温度传感器!\r\n");
				
		return 0;
	}
	
  i2c_Start();                       // 发起始信号
  i2c_SendByte(LM75_ADDRESS);     // 发写从机写寻址字节
	/* 等待ACK */
	if (i2c_WaitAck() != 0)
	{
		goto LM75_fail;	/* 器件无应答，异常处理 */
	}
	
  i2c_SendByte(LM75_TEMP_REGISTER);     // 发Temp reg address
	if (i2c_WaitAck() != 0)
	{
		goto LM75_fail;	/* 器件无应答 */
	}
	
  i2c_Start();                       // 发起始信号
  i2c_SendByte(LM75_ADDRESS | I2C_RD); // 发从机读寻址字节
	if (i2c_WaitAck() != 0)
	{
		goto LM75_fail;	/* 器件无应答 */
	}

	tempH = i2c_ReadByte();                // 读第一个字节数据
	i2c_Ack();
  tempL = i2c_ReadByte();  	  // 读第二个字节数据
	i2c_NAck();	
  i2c_Stop();                        // 发停止信号
  data = (tempH<<8)|tempL;
	return ((float)(data >> 5)) * 0.125;
 
LM75_fail: /* 命令执行失败后，切记发送停止信号，避免影响I2C总线上其他设备 */
	/* 发送I2C总线停止信号 */
	i2c_Stop();
  return tempH;
}
/*********************************************END OF FILE**********************/
